#include "gfx.h"
#include "hal.h"

shader_t gfx_bg;

/* Classic 5x7 font, ASCII 32..126, column-major, bit 0 = top row. */
static const uint8_t font[] PROGMEM = {
    0x00,0x00,0x00,0x00,0x00, 0x00,0x00,0x5F,0x00,0x00, 0x00,0x07,0x00,0x07,0x00, 0x14,0x7F,0x14,0x7F,0x14,
    0x24,0x2A,0x7F,0x2A,0x12, 0x23,0x13,0x08,0x64,0x62, 0x36,0x49,0x56,0x20,0x50, 0x00,0x08,0x07,0x03,0x00,
    0x00,0x1C,0x22,0x41,0x00, 0x00,0x41,0x22,0x1C,0x00, 0x2A,0x1C,0x7F,0x1C,0x2A, 0x08,0x08,0x3E,0x08,0x08,
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    0x00,0x00,0x77,0x00,0x00, 0x00,0x41,0x36,0x08,0x00, 0x02,0x01,0x02,0x04,0x02,
};

static const uint8_t bayer[16] = { 0, 8, 2, 10, 12, 4, 14, 6, 3, 11, 1, 9, 15, 7, 13, 5 };

uint16_t gfx_mix(uint16_t c0, uint16_t c1, uint8_t t, uint8_t x, uint8_t y)
{
    uint16_t d = (uint16_t)(bayer[((y & 3) << 2) | (x & 3)] << 4);
    uint16_t u = (uint16_t)(256 - t);
    uint16_t r = (uint16_t)(((c0 >> 11) * u + (c1 >> 11) * t + d) >> 8);
    uint16_t g = (uint16_t)((((c0 >> 5) & 63) * u + ((c1 >> 5) & 63) * t + d) >> 8);
    uint16_t b = (uint16_t)(((c0 & 31) * u + (c1 & 31) * t + d) >> 8);
    return (uint16_t)((r << 11) | (g << 5) | b);
}

void gfx_fill(uint8_t x, uint8_t y, uint8_t w, uint8_t h, uint16_t c)
{
    if (!w || !h) return;
    lcd_window(x, y, (uint8_t)(x + w - 1), (uint8_t)(y + h - 1));
    lcd_fill(c, (uint16_t)w * h);
}

void gfx_shade(uint8_t x, uint8_t y, uint8_t w, uint8_t h, shader_t s)
{
    if (!w || !h) return;
    lcd_window(x, y, (uint8_t)(x + w - 1), (uint8_t)(y + h - 1));
    for (uint8_t j = 0; j < h; j++)
        for (uint8_t i = 0; i < w; i++)
            lcd_px(s((uint8_t)(x + i), (uint8_t)(y + j)));
}

static uint8_t glyph[6];

static uint8_t glyph_bit(int8_t u, int8_t v)
{
    if (u < 0 || v < 0 || u > 5 || v > 7) return 0;
    return (uint8_t)((glyph[u] >> v) & 1);
}

void gfx_char(uint8_t x, uint8_t y, char ch, uint16_t fg, uint16_t shadow, uint8_t scale)
{
    if (ch < 32 || ch > 126) ch = '?';
    const uint8_t *g = font + (uint16_t)(ch - 32) * 5;
    for (uint8_t i = 0; i < 5; i++) glyph[i] = RD8(g + i);
    glyph[5] = 0;

    uint8_t sh = (shadow != NO_SHADOW) ? 1 : 0;
    uint8_t w = (uint8_t)(FONT_W * scale + sh), h = (uint8_t)(FONT_H * scale + sh);
    if (x + w > LCD_W) w = (uint8_t)(LCD_W - x);
    if (y + h > LCD_H) h = (uint8_t)(LCD_H - y);
    lcd_window(x, y, (uint8_t)(x + w - 1), (uint8_t)(y + h - 1));
    for (uint8_t j = 0; j < h; j++) {
        int8_t v = (int8_t)(j / scale);
        int8_t vs = j ? (int8_t)((j - 1) / scale) : -1;
        for (uint8_t i = 0; i < w; i++) {
            int8_t u = (int8_t)(i / scale);
            uint16_t c;
            if (glyph_bit(u, v)) c = fg;
            else if (sh && i > 0 && glyph_bit((int8_t)((i - 1) / scale), vs)) c = shadow;
            else c = gfx_bg((uint8_t)(x + i), (uint8_t)(y + j));
            lcd_px(c);
        }
    }
}

uint8_t gfx_strlen(const char *s)
{
    uint8_t n = 0;
    while (s[n]) n++;
    return n;
}

uint8_t gfx_text(uint8_t x, uint8_t y, const char *s, uint16_t fg, uint16_t shadow, uint8_t scale)
{
    while (*s && x < LCD_W) {
        gfx_char(x, y, *s++, fg, shadow, scale);
        x = (uint8_t)(x + FONT_W * scale);
    }
    return x;
}

void gfx_text_c(uint8_t y, const char *s, uint16_t fg, uint16_t shadow, uint8_t scale)
{
    uint8_t w = (uint8_t)(gfx_strlen(s) * FONT_W * scale);
    uint8_t x = w < LCD_W ? (uint8_t)((LCD_W - w + 1) / 2) : 0;
    gfx_text(x, y, s, fg, shadow, scale);
}

uint8_t gfx_wrap(uint8_t x, uint8_t y, uint8_t cols, uint8_t max_lines, uint8_t line_h,
                 const char *s, uint16_t fg, uint8_t ms_per_char, uint8_t centered)
{
    uint8_t lines = 0;
    while (*s && lines < max_lines) {
        while (*s == ' ') s++;
        uint8_t len = 0, cut = 0;
        while (s[len] && len < cols) {
            if (s[len] == ' ') cut = len;
            len++;
        }
        if (s[len] && s[len] != ' ' && cut) len = cut;
        if (fg != NO_SHADOW) {
            uint8_t lx = centered ? (uint8_t)(x + (cols - len) * FONT_W / 2) : x;
            for (uint8_t i = 0; i < len; i++) {
                gfx_char((uint8_t)(lx + i * FONT_W), y, s[i], fg, NO_SHADOW, 1);
                if (ms_per_char) {
                    if (hal_btn_take()) ms_per_char = 0;
                    else if (s[i] != ' ') hal_delay(ms_per_char);
                }
            }
        }
        s += len;
        y = (uint8_t)(y + line_h);
        lines++;
    }
    return lines;
}
